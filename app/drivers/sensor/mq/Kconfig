## app/drivers/sensor/mq/Kconfig
```kconfig
config MQ
  bool "MQ gas sensor"
  default n
  select SENSOR
  select ADC
  select FPU if CPU_HAS_FPU
```

## app/src/can_service/Kconfig.can_service
```kconfig
config CAN_SERVICE_TX_INTERVAL_MS
  int "Period between telemetry frame bursts, in milliseconds"
  default 500

config CAN_SERVICE_STACK_SIZE
  int "Size of the stack dedicated for the CAN work queue"
  default 1024

config CAN_SERVICE_PRIORITY
  int "Priority of the CAN work queue (below sensors, above UI)"
  default 2
```

## app/src/device_status/Kconfig.device_status
```kconfig
config TILT_SIM
  bool "Simulate tilt sensor readings"
  default y
  help
    Feeds synthetic X/Y/Z tilt values (slow drift plus periodic shake
    bursts) into device_status_set_tilt(), standing in for a real
    accelerometer driver so the Tilt screen can be exercised without
    hardware. Disable once a real tilt sensor driver is wired in.

config ENV_SIM
  bool "Simulate environment sensor readings"
  default y
  help
    Feeds a synthetic ppm reading (slow drift plus noise) and its
    matching simulated ADC voltage into device_status_set_environment(),
    standing in for a real environment sensor driver so the Environment
    screen can be exercised without hardware. Disable once a real
    environment sensor driver is wired in.
```

## app/src/ui/Kconfig.ui
```kconfig
config UI_THREAD_STACK_SIZE
  int "Size of the stack dedicated for the UI thread"
  default 8192

config UI_THREAD_PRIORITY
  int "Priority of UI thread"
  default 5
```

## west.yml
```yaml
manifest:
  version: 1.0

  projects:
    - name: zephyr
      url: https://github.com/zephyrproject-rtos/zephyr
      revision: v4.4.2
      import:
        name-allowlist:
          - cmsis_6
          - hal_nxp
          - lvgl
        path-prefix: deps
```
